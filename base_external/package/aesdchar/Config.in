## base_external/package/aesdchar/Config.in
```kconfig
config BR2_PACKAGE_AESDCHAR
	bool "aesdchar"
	help
	  Includes the aesdchar driver in kernel image
	  Used to understand building kernel modules in kernel image
```

## base_external/package/ldd/Config.in
```kconfig
config BR2_PACKAGE_LDD
	bool "ldd"
	help
	  Includes the ldds misc-modules and scull in kernel image
	  Used to understand building kernel modules in kernel image
```
